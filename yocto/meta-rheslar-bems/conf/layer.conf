## yocto/meta-rheslar-bems/conf/layer.conf
```bitbake
BBPATH .= ":${LAYERDIR}"
BBFILES += "${LAYERDIR}/recipes-*/*/*.bb ${LAYERDIR}/recipes-*/*/*.bbappend"
BBFILE_COLLECTIONS += "rheslar-bems"
BBFILE_PATTERN_rheslar-bems = "^${LAYERDIR}/"
BBFILE_PRIORITY_rheslar-bems = "7"
LAYERSERIES_COMPAT_rheslar-bems = "scarthgap styhead"
```
